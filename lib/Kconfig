## lib/Kconfig
```kconfig
#
# Copyright (c) 2018 Nordic Semiconductor
#
# SPDX-License-Identifier: LicenseRef-BSD-5-Clause-Nordic
#

menu "Libraries"

rsource "at_cmd_parser/Kconfig"

rsource "at_host/Kconfig"

rsource "at_notif/Kconfig"

rsource "bin/Kconfig"

rsource "bsdlib/Kconfig"

rsource "dk_buttons_and_leds/Kconfig"

rsource "modem_info/Kconfig"

rsource "multithreading_lock/Kconfig"

rsource "pdn_management/Kconfig"

rsource "sms/Kconfig"

endmenu
```
