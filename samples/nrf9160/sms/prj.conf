## CMakeLists.txt
```
#
# Copyright (c) 2019 Nordic Semiconductor
#
# SPDX-License-Identifier: LicenseRef-BSD-5-Clause-Nordic
#

cmake_minimum_required(VERSION 3.8.2)

include(../../../cmake/boilerplate.cmake)
include($ENV{ZEPHYR_BASE}/cmake/app/boilerplate.cmake NO_POLICY_SCOPE)
project(NONE)

# NORDIC SDK APP START
target_sources(app PRIVATE src/main.c)
# NORDIC SDK APP END
```

## sample.yaml
```
sample:
  name: SMS Sample
tests:
  test_build:
    build_only: true
    build_on_all: true
    platform_whitelist: nrf9160_pca10090ns
    tags: ci_build
```

## prj.conf
```kconfig
#
# Copyright (c) 2019 Nordic Semiconductor ASA
#
# SPDX-License-Identifier: LicenseRef-BSD-5-Clause-Nordic
#
# General config
CONFIG_ASSERT=y
CONFIG_TEST_RANDOM_GENERATOR=y

# Network
CONFIG_NETWORKING=y
CONFIG_NET_NATIVE=n
CONFIG_NET_SOCKETS=y
CONFIG_NET_SOCKETS_OFFLOAD=y

# BSD library
CONFIG_BSD_LIBRARY=y

# LTE link control
CONFIG_LTE_LINK_CONTROL=y
CONFIG_LTE_NETWORK_MODE_LTE_M_GPS=y
CONFIG_LTE_AUTO_INIT_AND_CONNECT=y
CONFIG_LTE_LINK_CONTROL_LOG_LEVEL_DBG=y

# Stacks and heaps
CONFIG_MAIN_STACK_SIZE=3072
CONFIG_HEAP_MEM_POOL_SIZE=16384

# SMS subscriber module
CONFIG_SMS=y

CONFIG_AT_NOTIF_SYS_INIT=y

# Logger
CONFIG_LOG=y
CONFIG_LOG_PRINTK=y
CONFIG_UART_0_NRF_FLOW_CONTROL=y

CONFIG_LOG_DEFAULT_LEVEL=4

CONFIG_SMS_LOG_LEVEL_DBG=y
CONFIG_AT_NOTIF_LOG_LEVEL_DBG=y

# At command dispatch
CONFIG_AT_CMD_LOG_LEVEL_DBG=y
```

## src/main.c
```c
/*
 * Copyright (c) 2019 Nordic Semiconductor ASA
 *
 * SPDX-License-Identifier: LicenseRef-BSD-5-Clause-Nordic
 */

#include <zephyr.h>
#include <stdio.h>
#include <uart.h>
#include <string.h>

/* SMS subscriber module. */
#include <sms.h>

/**@brief Recoverable BSD library error. */
void bsd_recoverable_error_handler(uint32_t err)
{
	printk("bsdlib recoverable error: %u\n", err);
}

/** @brief Configures modem to provide LTE link. */
static void modem_configure(void)
{
#if defined(CONFIG_LTE_LINK_CONTROL)
	BUILD_ASSERT_MSG(IS_ENABLED(CONFIG_LTE_AUTO_INIT_AND_CONNECT),
			"LTE init and connect need to be enabled");

	// int err = at_notif_init();
	// __ASSERT(err == 0, "AT Notify could not be initialized.");
	// err = at_cmd_init();
	// __ASSERT(err == 0, "AT CMD could not be established.");
	// printk("LTE Link Connecting ...\n");
	// err = lte_lc_init_and_connect();
	// __ASSERT(err == 0, "LTE link could not be established.");
	// printk("LTE Link Connected!\n");
#endif
}

void sms_handler(struct sms_data *const data, void *context)
{
	printk("SMS data\n");
	printk("Data: %d\n", data->length);
}

int context = 42;

void main(void)
{
	printk("SMS sample started\n");

	/* LTE link is established automatically. */
	modem_configure();

	int ret = sms_init();
	if (ret) {
		printk("Unable to register SMS client: %d\n", ret);
		return;
	}

	bool registered = sms_register_listener(sms_handler, &context);

	(void)registered;
	(void)ret;

//	while(true) {
//		k_sleep(1);
//	}
}
```
